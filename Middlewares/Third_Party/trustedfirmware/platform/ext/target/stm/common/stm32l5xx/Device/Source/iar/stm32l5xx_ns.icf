#include "region_defs.h"


define block ER_CODE            with fixed order, alignment = 8 {
       section .intvec,
       readonly};
define block LR_CODE with fixed order, maximum size = NS_CODE_SIZE {block ER_CODE};
place at address NS_CODE_START {block LR_CODE};

define block ER_DATA with alignment = 8 {readwrite};
define block ARM_LIB_STACK_MSP  with alignment = 32, size = NS_MSP_STACK_SIZE { };
define block ARM_LIB_STACK      with alignment = 32, size = NS_PSP_STACK_SIZE { };
define block HEAP               with alignment = 8, size = NS_HEAP_SIZE { };
define block ARM_LIB_HEAP       with alignment = 8, size = NS_HEAP_SIZE { };
define overlay HEAP_OVL         {block HEAP};
define overlay HEAP_OVL         {block ARM_LIB_HEAP};
keep {block ARM_LIB_STACK_MSP, block ARM_LIB_STACK,
      block HEAP, block ARM_LIB_HEAP};

do not initialize  { section .noinit };
initialize by copy { readwrite };
if (isdefinedsymbol(__USE_DLIB_PERTHREAD))
{
  // Required in a multi-threaded application
  initialize by copy with packing = none { section __DLIB_PERTHREAD };
}

define block DATA with fixed order, maximum size = NS_DATA_SIZE {
       block ER_DATA,
       block ARM_LIB_STACK_MSP,
       block ARM_LIB_STACK,
       overlay HEAP_OVL
};
place at address NS_DATA_START {block DATA};
