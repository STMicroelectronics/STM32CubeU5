# file: LPTIM_IC_LSE.ioc
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CORTEX_M33_NS.userName=CORTEX_M33
LPDMA1.DESTDATAWIDTH_LPDMACH0=DMA_DEST_DATAWIDTH_HALFWORD
LPDMA1.DESTINC_LPDMACH0=DMA_DINC_INCREMENTED
LPDMA1.IPHANDLE_LPDMACH0-SIMPLEREQUEST_LPDMACH0=__NULL
LPDMA1.PRIORITY_LPDMACH0=DMA_HIGH_PRIORITY
LPDMA1.REQUEST_LPDMACH0=LPDMA1_REQUEST_LPTIM1_IC1
LPDMA1.SRCDATAWIDTH_LPDMACH0=DMA_SRC_DATAWIDTH_HALFWORD
LPTIM1.Period=0xFFFF
Mcu.Family=STM32U5
Mcu.Name=STM32U575ZITxQ
Mcu.Package=LQFP144
NVIC.LPDMA1_Channel0_IRQn=true\:0\:0\:false\:false\:true\:false\:true\:true
NVIC.PriorityGroup=NVIC_PRIORITYGROUP_4
PB2.GPIO_PuPd=GPIO_PULLUP
PB2.GPIO_Speed=GPIO_SPEED_FREQ_MEDIUM
PB2.Signal=S_LPTIM1_CH1
PC14-OSC32_IN\ (PC14).Mode=LSE-External-Oscillator
PC14-OSC32_IN\ (PC14).Signal=RCC_OSC32_IN
PC15-OSC32_OUT\ (PC15).Mode=LSE-External-Oscillator
PC15-OSC32_OUT\ (PC15).Signal=RCC_OSC32_OUT
PWR.PowerMode=PWR_SMPS_SUPPLY
ProjectManager.HeapSize=0x200
ProjectManager.StackSize=0x400
ProjectManager.TargetToolchain=EWARM V8.32
RCC.ADCFreq_Value=16000000
RCC.AHBFreq_Value=160000000
RCC.APB1Freq_Value=160000000
RCC.APB1TimFreq_Value=160000000
RCC.APB2Freq_Value=160000000
RCC.APB2TimFreq_Value=160000000
RCC.APB3Freq_Value=160000000
RCC.CortexFreq_Value=160000000
RCC.DACCLockSelectionVirtual=RCC_DAC1CLKSOURCE_LSI
RCC.DACCLockSelectionVirtualString=RCC_DAC1CLKSOURCE_LSI
RCC.EPOD_VALUE=4000000
RCC.HCLKFreq_Value=160000000
RCC.HSE_VALUE=16000000
RCC.HSI48_VALUE=48000000
RCC.HSI_VALUE=16000000
RCC.LPTIM1CLockSelectionVirtual=RCC_LPTIM1CLKSOURCE_LSE
RCC.LSE_Drive_Capability=RCC_LSEDRIVE_MEDIUMHIGH
RCC.LSIDIV_VALUE=32000
RCC.MSI_VALUE=4000000
RCC.PLLN=80
RCC.SYSCLKFreq_VALUE=160000000
RCC.SYSCLKSource=RCC_SYSCLKSOURCE_PLLCLK
RCC.USBFreq_Value=48000000
RCC.VCOOutputFreq_Value=320000000
SH.S_LPTIM1_CH1.0=LPTIM1_CH1
VP_ICACHE_VS_ICACHE.Mode=DirectMappedCache
VP_LPBAMQUEUE_VS_QUEUE.Mode=QUEUEMODE
VP_LPBAM_VS_SIG1.Mode=SmartRun
VP_LPBAM_VS_SIG4.Mode=LPDMA1
VP_LPDMA1_VS_LPDMACH0.Mode=SIMPLEREQUEST_LPDMACH0
VP_LPTIM1_VS_LPTIM_counterModeInternalClock.Mode=Counts__internal_clock_event_00
VP_PWR_VS_DBSignals.Mode=DisableDeadBatterySignals
VP_PWR_VS_LPOM.Mode=PowerOptimisation
VP_PWR_VS_SECSignals.Mode=Security/Privilege
board=custom

// file: Src/main.c
/* USER CODE BEGIN Header */
/**
  ******************************************************************************
  * @file           : main.c
  * @brief          : Main program body
  ******************************************************************************
  * @attention
  *
  * Copyright (c) 2021 STMicroelectronics.
  * All rights reserved.
  *
  * This software is licensed under terms that can be found in the LICENSE file
  * in the root directory of this software component.
  * If no LICENSE file comes with this software, it is provided AS-IS.
  *
  ******************************************************************************
  */
/* USER CODE END Header */
#include "main.h"

/* USER CODE BEGIN PD */
#define MAX_TOLERANCE           1.10
#define MIN_TOLERANCE           0.90
/* USER CODE END PD */

LPTIM_HandleTypeDef hlptim1;
DMA_HandleTypeDef handle_LPDMA1_Channel0;

/* USER CODE BEGIN PV */
/* Channel_config structure declaration */
static LPTIM_IC_ConfigTypeDef sConfig = {0};

static uint16_t        Measured_InputSignalFreq;
static uint16_t        Expected_InputSignalFreq;
static uint32_t        InputSignalFreq = 100;  /* 100hz */

#if defined ( __ICCARM__ ) /* IAR Compiler */
#pragma location=(SRAM4_BASE)
#elif defined ( __ARMCC_VERSION ) /* MDK ARM Compiler */
__attribute__((section(".SRAM4")))
#elif defined ( __GNUC__ ) /* GNU Compiler */
__attribute__((section(".SRAM4")))
#endif

uint16_t        SRD_DmaCapturedValue[2] = {0};
/* USER CODE END PV */

void SystemClock_Config(void);
static void SystemPower_Config(void);
static void MX_GPIO_Init(void);
static void MX_LPDMA1_Init(void);
static void MX_ICACHE_Init(void);
static void MX_LPTIM1_Init(void);

int main(void)
{

  /* USER CODE BEGIN 1 */
  /* STM32U5xx HAL library initialization:
       - Configure the Flash prefetch
       - Configure the Systick to generate an interrupt each 1 msec
       - Set NVIC Group Priority to 3
       - Low Level Initialization
     */
  /* USER CODE END 1 */

  /* MCU Configuration--------------------------------------------------------*/

  /* Reset of all peripherals, Initializes the Flash interface and the Systick. */
  HAL_Init();

  /* Configure the System Power */
  SystemPower_Config();

  /* Configure the system clock */
  SystemClock_Config();

  /* USER CODE BEGIN SysInit */
  /* Configure LED3 */
  BSP_LED_Init(LED3);
  /* Configure LED1 */
  BSP_LED_Init(LED1);
  /* USER CODE END SysInit */

  /* Initialize all configured peripherals */
  MX_GPIO_Init();
  MX_LPDMA1_Init();
  MX_ICACHE_Init();
  MX_LPTIM1_Init();
  /* USER CODE BEGIN 2 */
  sConfig.ICInputSource = LPTIM_IC1SOURCE_GPIO;
  sConfig.ICFilter      = LPTIM_ICFLT_CLOCK_DIV1;
  sConfig.ICPolarity    = LPTIM_ICPOLARITY_RISING;
  sConfig.ICPrescaler   = LPTIM_ICPSC_DIV1;
  if (HAL_LPTIM_IC_ConfigChannel(&hlptim1, &sConfig, LPTIM_CHANNEL_1) != HAL_OK)
  {
    Error_Handler();
  }

  if (HAL_LPTIM_IC_Start_DMA(&hlptim1, LPTIM_CHANNEL_1, (uint32_t *)SRD_DmaCapturedValue, 4) != HAL_OK)
  {
    Error_Handler();
  }

  /* Suspend Tick */
  HAL_SuspendTick();

 /* Enter in Stop mode */
 __HAL_RCC_PWR_CLK_ENABLE();
 HAL_PWREx_EnterSTOP2Mode(PWR_STOPENTRY_WFI);

 /* Check that the system was resumed from stop 2 */
 if (__HAL_PWR_GET_FLAG(PWR_FLAG_STOPF) == 0U)
 {
   Error_Handler();
 }

 /* Clear stop flag */
 __HAL_PWR_CLEAR_FLAG(PWR_FLAG_STOPF);

 /* Check that stop flag is cleared */
 if (__HAL_PWR_GET_FLAG(PWR_FLAG_STOPF) != 0U)
 {
   Error_Handler();
 }

  /* Compute expected tick value */
  Expected_InputSignalFreq = ((LSE_VALUE) / InputSignalFreq);

  /* Suspend Tick */
  HAL_ResumeTick();

  HAL_Delay(10);

  /* Get the Input Capture value */
  if (SRD_DmaCapturedValue[1] > SRD_DmaCapturedValue[0])
  {
    Measured_InputSignalFreq = SRD_DmaCapturedValue[1] - SRD_DmaCapturedValue[0];
  }
  else if (SRD_DmaCapturedValue[1] < SRD_DmaCapturedValue[0])
  {
    /* 0xFFFF is max LPTIM1_CCRx value */
    Measured_InputSignalFreq = ((0xFFFF - SRD_DmaCapturedValue[0]) + SRD_DmaCapturedValue[1]) + 1;
  }
  else
  {
    /* If capture values are equal, we have reached the limit of frequency
    measures */
    Error_Handler();
  }

  if ((Measured_InputSignalFreq  < (Expected_InputSignalFreq * MAX_TOLERANCE)) &&
      (Measured_InputSignalFreq  > (Expected_InputSignalFreq * MIN_TOLERANCE)))
  {
    BSP_LED_On(LED1);
  }

  if (HAL_LPTIM_IC_Stop_DMA(&hlptim1, LPTIM_CHANNEL_1) != HAL_OK)
  {
    Error_Handler();
  }
  /* USER CODE END 2 */

  /* Infinite loop */
  while (1)
  {

  }
}

void SystemClock_Config(void)
{
  RCC_OscInitTypeDef RCC_OscInitStruct = {0};
  RCC_ClkInitTypeDef RCC_ClkInitStruct = {0};

  /** Configure the main internal regulator output voltage
  */
  if (HAL_PWREx_ControlVoltageScaling(PWR_REGULATOR_VOLTAGE_SCALE1) != HAL_OK)
  {
    Error_Handler();
  }

  /** Configure LSE Drive Capability
  */
  HAL_PWR_EnableBkUpAccess();
  __HAL_RCC_LSEDRIVE_CONFIG(RCC_LSEDRIVE_MEDIUMHIGH);

  /** Initializes the CPU, AHB and APB buses clocks
  */
  RCC_OscInitStruct.OscillatorType = RCC_OSCILLATORTYPE_LSE|RCC_OSCILLATORTYPE_MSI;
  RCC_OscInitStruct.LSEState = RCC_LSE_ON;
  RCC_OscInitStruct.MSIState = RCC_MSI_ON;
  RCC_OscInitStruct.MSICalibrationValue = RCC_MSICALIBRATION_DEFAULT;
  RCC_OscInitStruct.MSIClockRange = RCC_MSIRANGE_4;
  RCC_OscInitStruct.PLL.PLLState = RCC_PLL_ON;
  RCC_OscInitStruct.PLL.PLLSource = RCC_PLLSOURCE_MSI;
  RCC_OscInitStruct.PLL.PLLMBOOST = RCC_PLLMBOOST_DIV1;
  RCC_OscInitStruct.PLL.PLLM = 1;
  RCC_OscInitStruct.PLL.PLLN = 80;
  RCC_OscInitStruct.PLL.PLLP = 2;
  RCC_OscInitStruct.PLL.PLLQ = 2;
  RCC_OscInitStruct.PLL.PLLR = 2;
  RCC_OscInitStruct.PLL.PLLRGE = RCC_PLLVCIRANGE_0;
  RCC_OscInitStruct.PLL.PLLFRACN = 0;
  if (HAL_RCC_OscConfig(&RCC_OscInitStruct) != HAL_OK)
  {
    Error_Handler();
  }

  /** Initializes the CPU, AHB and APB buses clocks
  */
  RCC_ClkInitStruct.ClockType = RCC_CLOCKTYPE_HCLK|RCC_CLOCKTYPE_SYSCLK
                              |RCC_CLOCKTYPE_PCLK1|RCC_CLOCKTYPE_PCLK2
                              |RCC_CLOCKTYPE_PCLK3;
  RCC_ClkInitStruct.SYSCLKSource = RCC_SYSCLKSOURCE_PLLCLK;
  RCC_ClkInitStruct.AHBCLKDivider = RCC_SYSCLK_DIV1;
  RCC_ClkInitStruct.APB1CLKDivider = RCC_HCLK_DIV1;
  RCC_ClkInitStruct.APB2CLKDivider = RCC_HCLK_DIV1;
  RCC_ClkInitStruct.APB3CLKDivider = RCC_HCLK_DIV1;

  if (HAL_RCC_ClockConfig(&RCC_ClkInitStruct, FLASH_LATENCY_4) != HAL_OK)
  {
    Error_Handler();
  }
}

/**
  * @brief Power Configuration
  * @retval None
  */
static void SystemPower_Config(void)
{

  /*
   * Disable the internal Pull-Up in Dead Battery pins of UCPD peripheral
   */
  HAL_PWREx_DisableUCPDDeadBattery();

  /*
   * Switch to SMPS regulator instead of LDO
   */
  if (HAL_PWREx_ConfigSupply(PWR_SMPS_SUPPLY) != HAL_OK)
  {
    Error_Handler();
  }
}

static void MX_ICACHE_Init(void)
{

  /** Enable instruction cache in 1-way (direct mapped cache)
  */
  if (HAL_ICACHE_ConfigAssociativityMode(ICACHE_1WAY) != HAL_OK)
  {
    Error_Handler();
  }
  if (HAL_ICACHE_Enable() != HAL_OK)
  {
    Error_Handler();
  }

}

static void MX_LPDMA1_Init(void)
{

  /* Peripheral clock enable */
  __HAL_RCC_LPDMA1_CLK_ENABLE();

  /* LPDMA1 interrupt Init */
    HAL_NVIC_SetPriority(LPDMA1_Channel0_IRQn, 0, 0);
    HAL_NVIC_EnableIRQ(LPDMA1_Channel0_IRQn);

}

static void MX_LPTIM1_Init(void)
{

  hlptim1.Instance = LPTIM1;
  hlptim1.Init.Clock.Source = LPTIM_CLOCKSOURCE_APBCLOCK_LPOSC;
  hlptim1.Init.Clock.Prescaler = LPTIM_PRESCALER_DIV1;
  hlptim1.Init.Trigger.Source = LPTIM_TRIGSOURCE_SOFTWARE;
  hlptim1.Init.Period = 0xFFFF;
  hlptim1.Init.UpdateMode = LPTIM_UPDATE_IMMEDIATE;
  hlptim1.Init.CounterSource = LPTIM_COUNTERSOURCE_INTERNAL;
  hlptim1.Init.Input1Source = LPTIM_INPUT1SOURCE_GPIO;
  hlptim1.Init.Input2Source = LPTIM_INPUT2SOURCE_GPIO;
  hlptim1.Init.RepetitionCounter = 0;
  if (HAL_LPTIM_Init(&hlptim1) != HAL_OK)
  {
    Error_Handler();
  }
  /* USER CODE BEGIN LPTIM1_Init 2 */
  /* Enable autonomous mode */
  __HAL_RCC_LPTIM1_CLKAM_ENABLE();
  __HAL_RCC_LPDMA1_CLKAM_ENABLE();
  __HAL_RCC_SRAM4_CLKAM_ENABLE();
  /* USER CODE END LPTIM1_Init 2 */

}

static void MX_GPIO_Init(void)
{

  /* GPIO Ports Clock Enable */
  __HAL_RCC_GPIOC_CLK_ENABLE();
  __HAL_RCC_GPIOB_CLK_ENABLE();

}

void Error_Handler(void)
{
  /* USER CODE BEGIN Error_Handler_Debug */
  /* Turn LED3 on */
  BSP_LED_On(LED3);
  __disable_irq();
  while (1)
  {
  }
  /* USER CODE END Error_Handler_Debug */
}
