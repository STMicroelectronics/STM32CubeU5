# file: RAMCFG_ECC_Error_Generation.ioc
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CORTEX_M33_NS.userName=CORTEX_M33
Mcu.Family=STM32U5
Mcu.Name=STM32U5A9NJHxQ
Mcu.Package=TFBGA216
NVIC.PriorityGroup=NVIC_PRIORITYGROUP_4
NVIC.RAMCFG_IRQn=true\:7\:0\:true\:false\:true\:true\:true\:true
PWR.PowerMode=PWR_SMPS_SUPPLY
ProjectManager.HeapSize=0x200
ProjectManager.StackSize=0x400
ProjectManager.TargetToolchain=EWARM V8.50
RAMCFG.ErrorCodeCorrection-RAMCFG3_Activate=ECC_DISABLE
RAMCFG.Instance-RAMCFG3_Activate=RAMCFG_SRAM3
RCC.ADCFreq_Value=16000000
RCC.AHBFreq_Value=160000000
RCC.APB1Freq_Value=160000000
RCC.APB1TimFreq_Value=160000000
RCC.APB2Freq_Value=160000000
RCC.APB2TimFreq_Value=160000000
RCC.APB3Freq_Value=160000000
RCC.CortexFreq_Value=160000000
RCC.DACCLockSelectionVirtual=RCC_DAC1CLKSOURCE_LSI
RCC.DACCLockSelectionVirtualString=RCC_DAC1CLKSOURCE_LSI
RCC.EPOD_VALUE=4000000
RCC.HCLKFreq_Value=160000000
RCC.HSE_VALUE=16000000
RCC.HSI48_VALUE=48000000
RCC.HSI_VALUE=16000000
RCC.LSE_VALUE=32768
RCC.LSIDIV_VALUE=32000
RCC.MSI_VALUE=4000000
RCC.PLLN=80
RCC.SYSCLKFreq_VALUE=160000000
RCC.SYSCLKSource=RCC_SYSCLKSOURCE_PLLCLK
RCC.VCOOutputFreq_Value=320000000
VP_ICACHE_VS_ICACHE.Mode=DirectMappedCache
VP_PWR_VS_DBSignals.Mode=DisableDeadBatterySignals
VP_PWR_VS_LPOM.Mode=PowerOptimisation
VP_PWR_VS_SECSignals.Mode=Security/Privilege
VP_RAMCFG_VS_RAMCFG3.Mode=RAMCFG3_Activate
board=custom

// file: Src/main.c
/* USER CODE BEGIN Header */
/**
  ******************************************************************************
  * @file           : main.c
  * @brief          : Main program body
  ******************************************************************************
  * @attention
  *
  * Copyright (c) 2022 STMicroelectronics.
  * All rights reserved.
  *
  * This software is licensed under terms that can be found in the LICENSE file
  * in the root directory of this software component.
  * If no LICENSE file comes with this software, it is provided AS-IS.
  *
  ******************************************************************************
  */
/* USER CODE END Header */
#include "main.h"

/* USER CODE BEGIN PD */
/* Single and Double ECC error flags declaration */
__IO uint32_t ECC_SingleError = 0U, ECC_DoubleError = 0U;

/* Single and double error data buffers */
uint32_t SingleErrorData_Buffer[SRAM3_SIGNLE_ERROR_ADDRESS_SIZE];
uint32_t DoubleErrorData_Buffer[SRAM3_DOUBLE_ERROR_ADDRESS_SIZE];
/* USER CODE END PD */

RAMCFG_HandleTypeDef hramcfg_SRAM3;

void SystemClock_Config(void);
static void SystemPower_Config(void);
static void MX_ICACHE_Init(void);
static void MX_RAMCFG_Init(void);
/* USER CODE BEGIN PFP */
static void Fill_wMemory(uint32_t *pMemory, uint16_t MemorySize, uint32_t Data);
static void Read_wMemory(uint32_t *pMemory, uint32_t *pBuffer, uint16_t BufferSize);
static BufferContentStatus Check_wBuffer(uint32_t *pBuffer, uint16_t BufferSize, uint32_t CompareData);

static void SingleErrorDetectionCallback(RAMCFG_HandleTypeDef *hramcfg);
static void DoubleErrorDetectionCallback(RAMCFG_HandleTypeDef *hramcfg);

/* USER CODE END PFP */

int main(void)
{

  /* USER CODE BEGIN 1 */
  /* STM32U5xx HAL library initialization:
       - Configure the Flash prefetch
       - Configure the Systick to generate an interrupt each 1 msec
       - Set NVIC Group Priority to 3
       - Low Level Initialization
     */
  /* USER CODE END 1 */

  /* MCU Configuration--------------------------------------------------------*/

  /* Reset of all peripherals, Initializes the Flash interface and the Systick. */
  HAL_Init();

  /* Configure the system clock */
  SystemClock_Config();

  /* Configure the System Power */
  SystemPower_Config();

  /* USER CODE BEGIN SysInit */
  /* Initialize LED3 and LED4 : GREEN and RED leds */
  BSP_LED_Init(LED3);
  BSP_LED_Init(LED4);
  /* USER CODE END SysInit */

  /* Initialize all configured peripherals */
  MX_ICACHE_Init();
  MX_RAMCFG_Init();
  /* USER CODE BEGIN 2 */

    /* Register MSP Init callback for RAMCFG peripheral */
  if (HAL_RAMCFG_RegisterCallback(&hramcfg_SRAM3, HAL_RAMCFG_MSPINIT_CB_ID, HAL_RAMCFG_MspInit) != HAL_OK)
  {
    Error_Handler();
  }

  /* Register MSP Init callback for RAMCFG peripheral */
  if (HAL_RAMCFG_RegisterCallback(&hramcfg_SRAM3, HAL_RAMCFG_MSPDEINIT_CB_ID, HAL_RAMCFG_MspDeInit) != HAL_OK)
  {
    Error_Handler();
  }

  /* Initialize the RAMCFG peripheral */
  if (HAL_RAMCFG_Init(&hramcfg_SRAM3) != HAL_OK)
  {
    Error_Handler();
  }

  /* Erase the the hole SRAM3 */
  if (HAL_RAMCFG_Erase(&hramcfg_SRAM3) != HAL_OK)
  {
    Error_Handler();
  }

  /*##-2- Generate single and double ECC errors ##############################*/
  /* Start ECC for SRAM3 */
  if (HAL_RAMCFG_StartECC(&hramcfg_SRAM3) != HAL_OK)
  {
    Error_Handler();
  }

  /* Fill memory with known data */
  Fill_wMemory((uint32_t *)SRAM3_SIGNLE_ERROR_ADDRESS_BASE, (SRAM3_SIGNLE_ERROR_ADDRESS_SIZE * 2U), DATA_VALUE);

  /* Stop ECC for SRAM3 */
  if (HAL_RAMCFG_StopECC(&hramcfg_SRAM3) != HAL_OK)
  {
    Error_Handler();
  }

  /* Fill memory with single error data */
  Fill_wMemory((uint32_t *)SRAM3_SIGNLE_ERROR_ADDRESS_BASE, SRAM3_SIGNLE_ERROR_ADDRESS_SIZE, SINGLE_ERROR_DATA_VALUE);

  /* Fill memory with single error data */
  Fill_wMemory((uint32_t *)SRAM3_DOUBLE_ERROR_ADDRESS_BASE, SRAM3_DOUBLE_ERROR_ADDRESS_SIZE, DOUBLE_ERROR_DATA_VALUE);

  /*##-3- Read memory content and check that single and double ECC errors are
          generated ##########################################################*/
  /* Start ECC for SRAM3 */
  if (HAL_RAMCFG_StartECC(&hramcfg_SRAM3) != HAL_OK)
  {
    Error_Handler();
  }

  /* Register callback for RAMCFG peripheral single ECC error interrupt */
  if (HAL_RAMCFG_RegisterCallback(&hramcfg_SRAM3, HAL_RAMCFG_SE_DETECT_CB_ID, SingleErrorDetectionCallback) != HAL_OK)
  {
    Error_Handler();
  }

  /* Register callback for RAMCFG peripheral double ECC error interrupt */
  if (HAL_RAMCFG_RegisterCallback(&hramcfg_SRAM3, HAL_RAMCFG_DE_DETECT_CB_ID, DoubleErrorDetectionCallback) != HAL_OK)
  {
    Error_Handler();
  }

  /* Enable RAMECC single and double ECC error interrupts */
  if (HAL_RAMCFG_EnableNotification(&hramcfg_SRAM3, (RAMCFG_IT_SINGLEERR | RAMCFG_IT_DOUBLEERR)) != HAL_OK)
  {
    Error_Handler();
  }

  /* Read single error memory area */
  Read_wMemory((uint32_t *)SRAM3_SIGNLE_ERROR_ADDRESS_BASE, SingleErrorData_Buffer, SRAM3_SIGNLE_ERROR_ADDRESS_SIZE);

  /* Read double error memory area */
  Read_wMemory((uint32_t *)SRAM3_DOUBLE_ERROR_ADDRESS_BASE, DoubleErrorData_Buffer, SRAM3_DOUBLE_ERROR_ADDRESS_SIZE);

  /* Check that all single error data are corrected via RAMCFG peripheral */
  if (Check_wBuffer(SingleErrorData_Buffer, SRAM3_SIGNLE_ERROR_ADDRESS_SIZE, DATA_VALUE) != MATCH)
  {
    Error_Handler();
  }

  /* Check that all double error data are not corrected via RAMCFG peripheral */
  if (Check_wBuffer(DoubleErrorData_Buffer, SRAM3_DOUBLE_ERROR_ADDRESS_SIZE, DOUBLE_ERROR_DATA_VALUE) != MATCH)
  {
    Error_Handler();
  }

  /* Check the number of ECC single error detected */
  if (ECC_SingleError != EXPECTED_SINGLE_ERROR_NUM)
  {
    Error_Handler();
  }

  /* Check the number of ECC double error detected */
  if (ECC_DoubleError != EXPECTED_DOUBLE_ERROR_NUM)
  {
    Error_Handler();
  }

  /* DeInitialize the RAMCFG peripheral */
  if (HAL_RAMCFG_DeInit(&hramcfg_SRAM3) != HAL_OK)
  {
    Error_Handler();
  }

  /* USER CODE END 2 */

  /* Infinite loop */
  while (1)
  {

    /* USER CODE BEGIN 3 */
    HAL_Delay(250);
    BSP_LED_Toggle(LED3);
  }
  /* USER CODE END 3 */
}

void SystemClock_Config(void)
{
  RCC_OscInitTypeDef RCC_OscInitStruct = {0};
  RCC_ClkInitTypeDef RCC_ClkInitStruct = {0};

  /** Configure the main internal regulator output voltage
  */
  if (HAL_PWREx_ControlVoltageScaling(PWR_REGULATOR_VOLTAGE_SCALE1) != HAL_OK)
  {
    Error_Handler();
  }

  /** Initializes the CPU, AHB and APB buses clocks
  */
  RCC_OscInitStruct.OscillatorType = RCC_OSCILLATORTYPE_MSI;
  RCC_OscInitStruct.MSIState = RCC_MSI_ON;
  RCC_OscInitStruct.MSICalibrationValue = RCC_MSICALIBRATION_DEFAULT;
  RCC_OscInitStruct.MSIClockRange = RCC_MSIRANGE_4;
  RCC_OscInitStruct.PLL.PLLState = RCC_PLL_ON;
  RCC_OscInitStruct.PLL.PLLSource = RCC_PLLSOURCE_MSI;
  RCC_OscInitStruct.PLL.PLLMBOOST = RCC_PLLMBOOST_DIV1;
  RCC_OscInitStruct.PLL.PLLM = 1;
  RCC_OscInitStruct.PLL.PLLN = 80;
  RCC_OscInitStruct.PLL.PLLP = 2;
  RCC_OscInitStruct.PLL.PLLQ = 2;
  RCC_OscInitStruct.PLL.PLLR = 2;
  RCC_OscInitStruct.PLL.PLLRGE = RCC_PLLVCIRANGE_0;
  RCC_OscInitStruct.PLL.PLLFRACN = 0;
  if (HAL_RCC_OscConfig(&RCC_OscInitStruct) != HAL_OK)
  {
    Error_Handler();
  }

  /** Initializes the CPU, AHB and APB buses clocks
  */
  RCC_ClkInitStruct.ClockType = RCC_CLOCKTYPE_HCLK|RCC_CLOCKTYPE_SYSCLK
                              |RCC_CLOCKTYPE_PCLK1|RCC_CLOCKTYPE_PCLK2
                              |RCC_CLOCKTYPE_PCLK3;
  RCC_ClkInitStruct.SYSCLKSource = RCC_SYSCLKSOURCE_PLLCLK;
  RCC_ClkInitStruct.AHBCLKDivider = RCC_SYSCLK_DIV1;
  RCC_ClkInitStruct.APB1CLKDivider = RCC_HCLK_DIV1;
  RCC_ClkInitStruct.APB2CLKDivider = RCC_HCLK_DIV1;
  RCC_ClkInitStruct.APB3CLKDivider = RCC_HCLK_DIV1;

  if (HAL_RCC_ClockConfig(&RCC_ClkInitStruct, FLASH_LATENCY_4) != HAL_OK)
  {
    Error_Handler();
  }
}

/**
  * @brief Power Configuration
  * @retval None
  */
static void SystemPower_Config(void)
{

  /*
   * Disable the internal Pull-Up in Dead Battery pins of UCPD peripheral
   */
  HAL_PWREx_DisableUCPDDeadBattery();

  /*
   * Switch to SMPS regulator instead of LDO
   */
  if (HAL_PWREx_ConfigSupply(PWR_SMPS_SUPPLY) != HAL_OK)
  {
    Error_Handler();
  }
}

static void MX_ICACHE_Init(void)
{

  /** Enable instruction cache in 1-way (direct mapped cache)
  */
  if (HAL_ICACHE_ConfigAssociativityMode(ICACHE_1WAY) != HAL_OK)
  {
    Error_Handler();
  }
  if (HAL_ICACHE_Enable() != HAL_OK)
  {
    Error_Handler();
  }

}

static void MX_RAMCFG_Init(void)
{

  /** Initialize RAMCFG SRAM3
  */
  hramcfg_SRAM3.Instance = RAMCFG_SRAM3;
  if (HAL_RAMCFG_Init(&hramcfg_SRAM3) != HAL_OK)
  {
    Error_Handler();
  }

}

/* USER CODE BEGIN 4 */

/**
  * @brief  Fill a global 32-bit memory
  * @param  pMemory    : pointer on the Memory to fill
  * @param  MemorySize : size of the memory to fill
  * @param  Data       : data value
  * @retval None
  */
static void Fill_wMemory(uint32_t *pMemory, uint16_t MemorySize, uint32_t Data)
{
  __IO uint32_t IndexTmp;

  /* Repeat for all buffer size */
  for (IndexTmp = 0; IndexTmp < MemorySize; IndexTmp++)
  {
    pMemory[IndexTmp] = Data;
  }
}

/**
  * @brief  Read a global 32-bit memory
  * @param  pMemory    : pointer on the memory to read
  * @param  pBuffer    : pointer on the Buffer to fill
  * @param  BufferSize : size of the data to read
  * @retval None
  */
static void Read_wMemory(uint32_t *pMemory, uint32_t *pBuffer, uint16_t BufferSize)
{
  __IO uint32_t IndexTmp;
  uint32_t VarTmp;

  /* Repeat for all buffer size */
  for (IndexTmp = 0; IndexTmp < BufferSize; IndexTmp++)
  {
    VarTmp = pMemory[IndexTmp];
    pBuffer[IndexTmp] = VarTmp;
  }
}

/**
  * @brief  Check a global 32-bit buffer content
  * @param  pBuffer      : pointer on the Buffer to check
  * @param  BufferSize   : size of the data to check
  * @param  ComparedData : data to be compared with buffer content
  * @retval None
  */
static BufferContentStatus Check_wBuffer(uint32_t *pBuffer, uint16_t BufferSize, uint32_t CompareData)
{
  __IO uint32_t IndexTmp;

  /* Repeat for all buffer size */
  for (IndexTmp = 0; IndexTmp < BufferSize; IndexTmp++)
  {
    if (pBuffer[IndexTmp] != CompareData)
    {
      return NOTMATCH;
    }
  }

  return MATCH;
}

/**
  * @brief  RAMCFG single error detection callback
  * @param  hramcfg : Pointer to a RAMCFG_HandleTypeDef structure that contains
  *                   the configuration information for the specified RAMCFG
  * @retval None
  */
static void SingleErrorDetectionCallback(RAMCFG_HandleTypeDef *hramcfg)
{
  ECC_SingleError++;
}

/**
  * @brief  RAMCFG single error detection callback
  * @param  hramcfg : Pointer to a RAMCFG_HandleTypeDef structure that contains
  *                   the configuration information for the specified RAMCFG
  * @retval None
  */
static void DoubleErrorDetectionCallback(RAMCFG_HandleTypeDef *hramcfg)
{
  ECC_DoubleError++;
}

/* USER CODE END 4 */

void Error_Handler(void)
{
  /* USER CODE BEGIN Error_Handler_Debug */
  /* User can add his own implementation to report the HAL error return state */
  __disable_irq();
  /* Turn LED4 on */
  BSP_LED_On(LED4);
  while (1)
  {
  }
  /* USER CODE END Error_Handler_Debug */
}
