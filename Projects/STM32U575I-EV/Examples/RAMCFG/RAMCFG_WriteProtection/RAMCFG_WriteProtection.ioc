# file: RAMCFG_WriteProtection.ioc
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CORTEX_M33_NS.userName=CORTEX_M33
GPDMA1.ADDRESSING2D_GPDMACH12=ENABLE
GPDMA1.BLKSRCADDROFFSET_GPDMACH12=-128
GPDMA1.DESTDATAWIDTH_GPDMACH12=DMA_DEST_DATAWIDTH_WORD
GPDMA1.DESTINC_GPDMACH12=DMA_DINC_INCREMENTED
GPDMA1.PRIORITY_GPDMACH12=DMA_LOW_PRIORITY_HIGH_WEIGHT
GPDMA1.REPEATCOUNT_GPDMACH12=8
GPDMA1.SRCDATAWIDTH_GPDMACH12=DMA_SRC_DATAWIDTH_WORD
GPDMA1.SRCINC_GPDMACH12=DMA_SINC_INCREMENTED
GPDMA1.TRANSFEREVENTMODE_GPDMACH12=DMA_TCEM_REPEATED_BLOCK_TRANSFER
Mcu.Family=STM32U5
Mcu.Name=STM32U575AIIxQ
Mcu.Package=UFBGA169
NVIC.GPDMA1_Channel12_IRQn=true\:0\:0\:false\:false\:true\:true\:true\:true
NVIC.PriorityGroup=NVIC_PRIORITYGROUP_4
NVIC.RAMCFG_IRQn=true\:0\:0\:false\:false\:true\:true\:true\:true
PWR.PowerMode=PWR_SMPS_SUPPLY
ProjectManager.HeapSize=0x200
ProjectManager.StackSize=0x400
ProjectManager.TargetToolchain=EWARM V8.50
RAMCFG.Instance-RAMCFG2_Activate=RAMCFG_SRAM2
RCC.ADCFreq_Value=16000000
RCC.AHBFreq_Value=160000000
RCC.APB1Freq_Value=160000000
RCC.APB1TimFreq_Value=160000000
RCC.APB2Freq_Value=160000000
RCC.APB2TimFreq_Value=160000000
RCC.APB3Freq_Value=160000000
RCC.CortexFreq_Value=160000000
RCC.DACCLockSelectionVirtual=RCC_DAC1CLKSOURCE_LSI
RCC.DACCLockSelectionVirtualString=RCC_DAC1CLKSOURCE_LSI
RCC.EPOD_VALUE=4000000
RCC.HCLKFreq_Value=160000000
RCC.HSE_VALUE=16000000
RCC.HSI48_VALUE=48000000
RCC.HSI_VALUE=16000000
RCC.LSE_VALUE=32768
RCC.LSIDIV_VALUE=32000
RCC.MSI_VALUE=4000000
RCC.PLLN=80
RCC.SYSCLKFreq_VALUE=160000000
RCC.SYSCLKSource=RCC_SYSCLKSOURCE_PLLCLK
RCC.USBFreq_Value=48000000
RCC.VCOOutputFreq_Value=320000000
VP_GPDMA1_VS_GPDMACH12.Mode=SIMPLEREQUEST_GPDMACH12
VP_ICACHE_VS_ICACHE.Mode=DirectMappedCache
VP_LPBAMQUEUE_VS_QUEUE.Mode=QUEUEMODE
VP_LPBAM_VS_SIG1.Mode=SmartRun
VP_LPBAM_VS_SIG4.Mode=LPDMA1
VP_PWR_VS_DBSignals.Mode=DisableDeadBatterySignals
VP_PWR_VS_LPOM.Mode=PowerOptimisation
VP_PWR_VS_SECSignals.Mode=Security/Privilege
VP_RAMCFG_VS_RAMCFG2.Mode=RAMCFG2_Activate
board=custom

// file: Src/main.c
/* USER CODE BEGIN Header */
/**
  ******************************************************************************
  * @file           : main.c
  * @brief          : Main program body
  ******************************************************************************
  * @attention
  *
  * Copyright (c) 2021 STMicroelectronics.
  * All rights reserved.
  *
  * This software is licensed under terms that can be found in the LICENSE file
  * in the root directory of this software component.
  * If no LICENSE file comes with this software, it is provided AS-IS.
  *
  ******************************************************************************
  */
/* USER CODE END Header */
#include "main.h"

/* USER CODE BEGIN PD */
/* DMA flags declaration */
__IO uint32_t TransferCompleteDetected = 0U, TransferErrorDetected = 0U;
uint32_t DMA_Flags;

/* Source data buffer */
static uint32_t aSRC_Buffer[BUFFER_SIZE] =
{
  0x01020304, 0x05060708, 0x090A0B0C, 0x0D0E0F10,
  0x11121314, 0x15161718, 0x191A1B1C, 0x1D1E1F20,
  0x21222324, 0x25262728, 0x292A2B2C, 0x2D2E2F30,
  0x31323334, 0x35363738, 0x393A3B3C, 0x3D3E3F40,
  0x41424344, 0x45464748, 0x494A4B4C, 0x4D4E4F50,
  0x51525354, 0x55565758, 0x595A5B5C, 0x5D5E5F60,
  0x61626364, 0x65666768, 0x696A6B6C, 0x6D6E6F70,
  0x71727374, 0x75767778, 0x797A7B7C, 0x7D7E7F80
};
/* USER CODE END PD */

DMA_HandleTypeDef handle_GPDMA1_Channel12;

RAMCFG_HandleTypeDef hramcfg_SRAM2;

void SystemClock_Config(void);
static void SystemPower_Config(void);
static void MX_GPDMA1_Init(void);
static void MX_ICACHE_Init(void);
static void MX_RAMCFG_Init(void);
/* USER CODE BEGIN PFP */
void Fill_SRAM2Page_DMA(uint32_t PageIdx);

static uint32_t Check_SRAM2Page_Content(uint32_t PageIdx, uint32_t WriteProtectionState);

static void TransferComplete(DMA_HandleTypeDef *hdma);
static void TransferError(DMA_HandleTypeDef *hdma);
/* USER CODE END PFP */

int main(void)
{

  /* USER CODE BEGIN 1 */
  /* STM32U5xx HAL library initialization:
       - Configure the Flash prefetch
       - Configure the Systick to generate an interrupt each 1 msec
       - Set NVIC Group Priority to 3
       - Low Level Initialization
     */
  /* USER CODE END 1 */

  /* MCU Configuration--------------------------------------------------------*/

  /* Reset of all peripherals, Initializes the Flash interface and the Systick. */
  HAL_Init();

  /* Configure the System Power */
  SystemPower_Config();

  /* Configure the system clock */
  SystemClock_Config();

  /* USER CODE BEGIN SysInit */
  /* Initialize LED5 and LED6 */
  BSP_LED_Init(LED5);
  BSP_LED_Init(LED6);

  /* USER CODE END SysInit */

  /* Initialize all configured peripherals */
  MX_GPDMA1_Init();
  MX_ICACHE_Init();
  MX_RAMCFG_Init();
  /* USER CODE BEGIN 2 */
  /* Register MSP Init callback for RAMCFG peripheral */
  if (HAL_RAMCFG_RegisterCallback(&hramcfg_SRAM2, HAL_RAMCFG_MSPINIT_CB_ID, HAL_RAMCFG_MspInit) != HAL_OK)
  {
    Error_Handler();
  }

  /* Register MSP Init callback for RAMCFG peripheral */
  if (HAL_RAMCFG_RegisterCallback(&hramcfg_SRAM2, HAL_RAMCFG_MSPDEINIT_CB_ID, HAL_RAMCFG_MspDeInit) != HAL_OK)
  {
    Error_Handler();
  }

  /* Erase the the whole SRAM2 */
  if (HAL_RAMCFG_Erase(&hramcfg_SRAM2) != HAL_OK)
  {
    Error_Handler();
  }

  /*##-2- Fill SRAM2 pages when all pages are unprotected ####################*/
  /* Repeat for all SRAM2 pages */
  for (uint32_t pageIdx = 0U; pageIdx < SRAM2_PAGE_NUM; pageIdx++)
  {
    Fill_SRAM2Page_DMA(pageIdx);

    /* Wait for end of transmission or an error occurred */
    while ((TransferCompleteDetected != (pageIdx + 1U)) && (TransferErrorDetected == 0U));

    /* Check DMA error */
    if (TransferErrorDetected == 1U)
    {
      Error_Handler();
    }
  }

  /* Check all SRAM2 pages content */
  for (uint32_t pageIdx = 0U; pageIdx < SRAM2_PAGE_NUM; pageIdx++)
  {
    if (Check_SRAM2Page_Content(pageIdx, UNPROTECTED) != 0U)
    {
      Error_Handler();
    }
  }

  /*##-3- Fill SRAM2 pages when half pages are unprotected ####################*/
  /* Reset DMA flags */
  TransferCompleteDetected = 0U;
  TransferErrorDetected    = 0U;

  /* Erase the the hole SRAM2 */
  if (HAL_RAMCFG_Erase(&hramcfg_SRAM2) != HAL_OK)
  {
    Error_Handler();
  }

  /* Repeat for all DMA pages */
  /* Enable write protection for odd index pages */
  for (uint32_t pageIdx = 0U; pageIdx < SRAM2_PAGE_NUM; pageIdx++)
  {
    if ((pageIdx % 2U) != 0U)
    {
      if (HAL_RAMCFG_EnableWriteProtection(&hramcfg_SRAM2, pageIdx, 1U) != HAL_OK)
      {
        Error_Handler();
      }
    }
  }

  /* Repeat for all SRAM2 pages */
  for (uint32_t pageIdx = 0U; pageIdx < SRAM2_PAGE_NUM; pageIdx++)
  {
    Fill_SRAM2Page_DMA(pageIdx);

    /* Wait for end of transmission or an error occurred */
    if ((pageIdx % 2U) != 0U)
    {
      while (TransferErrorDetected != ((pageIdx / 2U) + 1U));
    }
    else
    {
      while (TransferCompleteDetected != (pageIdx / 2U) + 1U);
    }
  }

  /* DMA transactions */
  if ((TransferCompleteDetected != (SRAM2_PAGE_NUM / 2U)) || (TransferErrorDetected != (SRAM2_PAGE_NUM / 2U)))
  {
    Error_Handler();
  }

  /* Check unprotected SRAM2 pages content */
  for (uint32_t pageIdx = 0U; pageIdx < SRAM2_PAGE_NUM; pageIdx++)
  {
    if ((pageIdx % 2U) != 0U)
    {
      if (Check_SRAM2Page_Content(pageIdx, PROTECTED) != 0U)
      {
        Error_Handler();
      }
    }
    else
    {
      if (Check_SRAM2Page_Content(pageIdx, UNPROTECTED) != 0U)
      {
        Error_Handler();
      }
    }
  }

  /*##-4- Fill SRAM2 pages when no pages are unprotected ####################*/
  /* Reset DMA flags */
  TransferCompleteDetected = 0U;
  TransferErrorDetected    = 0U;

  /* Erase the the hole SRAM2 */
  if (HAL_RAMCFG_Erase(&hramcfg_SRAM2) != HAL_OK)
  {
    Error_Handler();
  }

  /* Repeat for all DMA pages */
  /* Enable write protection for odd index pages */
  for (uint32_t pageIdx = 0U; pageIdx < SRAM2_PAGE_NUM; pageIdx++)
  {
    if ((pageIdx % 2U) == 0U)
    {
      if (HAL_RAMCFG_EnableWriteProtection(&hramcfg_SRAM2, pageIdx, 1U) != HAL_OK)
      {
        Error_Handler();
      }
    }
  }

  /* Repeat for all SRAM2 pages */
  for (uint32_t pageIdx = 0U; pageIdx < SRAM2_PAGE_NUM; pageIdx++)
  {
    Fill_SRAM2Page_DMA(pageIdx);

    /* Wait for end of transmission or an error occurred */
    while ((TransferErrorDetected != (pageIdx + 1U)) && (TransferCompleteDetected == 0U));

    /* Check DMA error */
    if (TransferCompleteDetected != 0U)
    {
      Error_Handler();
    }
  }

  /* Check unprotected SRAM2 pages content */
  for (uint32_t pageIdx = 0U; pageIdx < SRAM2_PAGE_NUM; pageIdx++)
  {
    if (Check_SRAM2Page_Content(pageIdx, PROTECTED) != 0U)
    {
      Error_Handler();
    }
  }
  /* USER CODE END 2 */

  /* Infinite loop */
  /* USER CODE BEGIN WHILE */
  while (1)
  {
    HAL_Delay(250);
    BSP_LED_Toggle(LED5);
    /* USER CODE END WHILE */

  }
}

void SystemClock_Config(void)
{
  RCC_OscInitTypeDef RCC_OscInitStruct = {0};
  RCC_ClkInitTypeDef RCC_ClkInitStruct = {0};

  /** Configure the main internal regulator output voltage
  */
  if (HAL_PWREx_ControlVoltageScaling(PWR_REGULATOR_VOLTAGE_SCALE1) != HAL_OK)
  {
    Error_Handler();
  }

  /** Initializes the CPU, AHB and APB buses clocks
  */
  RCC_OscInitStruct.OscillatorType = RCC_OSCILLATORTYPE_MSI;
  RCC_OscInitStruct.MSIState = RCC_MSI_ON;
  RCC_OscInitStruct.MSICalibrationValue = RCC_MSICALIBRATION_DEFAULT;
  RCC_OscInitStruct.MSIClockRange = RCC_MSIRANGE_4;
  RCC_OscInitStruct.PLL.PLLState = RCC_PLL_ON;
  RCC_OscInitStruct.PLL.PLLSource = RCC_PLLSOURCE_MSI;
  RCC_OscInitStruct.PLL.PLLMBOOST = RCC_PLLMBOOST_DIV1;
  RCC_OscInitStruct.PLL.PLLM = 1;
  RCC_OscInitStruct.PLL.PLLN = 80;
  RCC_OscInitStruct.PLL.PLLP = 2;
  RCC_OscInitStruct.PLL.PLLQ = 2;
  RCC_OscInitStruct.PLL.PLLR = 2;
  RCC_OscInitStruct.PLL.PLLRGE = RCC_PLLVCIRANGE_0;
  RCC_OscInitStruct.PLL.PLLFRACN = 0;
  if (HAL_RCC_OscConfig(&RCC_OscInitStruct) != HAL_OK)
  {
    Error_Handler();
  }

  /** Initializes the CPU, AHB and APB buses clocks
  */
  RCC_ClkInitStruct.ClockType = RCC_CLOCKTYPE_HCLK|RCC_CLOCKTYPE_SYSCLK
                              |RCC_CLOCKTYPE_PCLK1|RCC_CLOCKTYPE_PCLK2
                              |RCC_CLOCKTYPE_PCLK3;
  RCC_ClkInitStruct.SYSCLKSource = RCC_SYSCLKSOURCE_PLLCLK;
  RCC_ClkInitStruct.AHBCLKDivider = RCC_SYSCLK_DIV1;
  RCC_ClkInitStruct.APB1CLKDivider = RCC_HCLK_DIV1;
  RCC_ClkInitStruct.APB2CLKDivider = RCC_HCLK_DIV1;
  RCC_ClkInitStruct.APB3CLKDivider = RCC_HCLK_DIV1;

  if (HAL_RCC_ClockConfig(&RCC_ClkInitStruct, FLASH_LATENCY_4) != HAL_OK)
  {
    Error_Handler();
  }
}

/**
  * @brief Power Configuration
  * @retval None
  */
static void SystemPower_Config(void)
{

  /*
   * Disable the internal Pull-Up in Dead Battery pins of UCPD peripheral
   */
  HAL_PWREx_DisableUCPDDeadBattery();

  /*
   * Switch to SMPS regulator instead of LDO
   */
  if (HAL_PWREx_ConfigSupply(PWR_SMPS_SUPPLY) != HAL_OK)
  {
    Error_Handler();
  }
}

static void MX_GPDMA1_Init(void)
{

  DMA_RepeatBlockConfTypeDef RepeatBlockConfig = {0};

  /* Peripheral clock enable */
  __HAL_RCC_GPDMA1_CLK_ENABLE();

  /* GPDMA1 interrupt Init */
    HAL_NVIC_SetPriority(GPDMA1_Channel12_IRQn, 0, 0);
    HAL_NVIC_EnableIRQ(GPDMA1_Channel12_IRQn);

  handle_GPDMA1_Channel12.Instance = GPDMA1_Channel12;
  handle_GPDMA1_Channel12.Init.Request = DMA_REQUEST_SW;
  handle_GPDMA1_Channel12.Init.BlkHWRequest = DMA_BREQ_SINGLE_BURST;
  handle_GPDMA1_Channel12.Init.Direction = DMA_MEMORY_TO_MEMORY;
  handle_GPDMA1_Channel12.Init.SrcInc = DMA_SINC_INCREMENTED;
  handle_GPDMA1_Channel12.Init.DestInc = DMA_DINC_INCREMENTED;
  handle_GPDMA1_Channel12.Init.SrcDataWidth = DMA_SRC_DATAWIDTH_WORD;
  handle_GPDMA1_Channel12.Init.DestDataWidth = DMA_DEST_DATAWIDTH_WORD;
  handle_GPDMA1_Channel12.Init.Priority = DMA_LOW_PRIORITY_HIGH_WEIGHT;
  handle_GPDMA1_Channel12.Init.SrcBurstLength = 1;
  handle_GPDMA1_Channel12.Init.DestBurstLength = 1;
  handle_GPDMA1_Channel12.Init.TransferAllocatedPort = DMA_SRC_ALLOCATED_PORT0|DMA_DEST_ALLOCATED_PORT0;
  handle_GPDMA1_Channel12.Init.TransferEventMode = DMA_TCEM_REPEATED_BLOCK_TRANSFER;
  handle_GPDMA1_Channel12.Init.Mode = DMA_NORMAL;
  if (HAL_DMA_Init(&handle_GPDMA1_Channel12) != HAL_OK)
  {
    Error_Handler();
  }
  RepeatBlockConfig.RepeatCount = 8;
  RepeatBlockConfig.SrcAddrOffset = 0;
  RepeatBlockConfig.DestAddrOffset = 0;
  RepeatBlockConfig.BlkSrcAddrOffset = -128;
  RepeatBlockConfig.BlkDestAddrOffset = 0;
  if (HAL_DMAEx_ConfigRepeatBlock(&handle_GPDMA1_Channel12, &RepeatBlockConfig) != HAL_OK)
  {
    Error_Handler();
  }
  if (HAL_DMA_ConfigChannelAttributes(&handle_GPDMA1_Channel12, DMA_CHANNEL_NPRIV) != HAL_OK)
  {
    Error_Handler();
  }

}

static void MX_ICACHE_Init(void)
{

  /** Enable instruction cache in 1-way (direct mapped cache)
  */
  if (HAL_ICACHE_ConfigAssociativityMode(ICACHE_1WAY) != HAL_OK)
  {
    Error_Handler();
  }
  if (HAL_ICACHE_Enable() != HAL_OK)
  {
    Error_Handler();
  }

}

static void MX_RAMCFG_Init(void)
{

  /** Initialize RAMCFG SRAM2
  */
  hramcfg_SRAM2.Instance = RAMCFG_SRAM2;
  if (HAL_RAMCFG_Init(&hramcfg_SRAM2) != HAL_OK)
  {
    Error_Handler();
  }

}

/* USER CODE BEGIN 4 */
/**
  * @brief  Fill SRAM2 pages with DMA
  * @param  None
  * @retval None
  */
void Fill_SRAM2Page_DMA(uint32_t PageIdx)
{
  /* DMA Initialization Function */
  MX_GPDMA1_Init();

  /* Select Callbacks functions called after Half Transfer Complete, Transfer Complete and Transfer Error */
  HAL_DMA_RegisterCallback(&handle_GPDMA1_Channel12, HAL_DMA_XFER_CPLT_CB_ID, TransferComplete);
  HAL_DMA_RegisterCallback(&handle_GPDMA1_Channel12, HAL_DMA_XFER_ERROR_CB_ID, TransferError);

  /* Configure the source, destination and buffer size DMA fields and Start DMA Channel/Stream transfer */
  /* Enable All the DMA interrupts */
  if (HAL_DMA_Start_IT(&handle_GPDMA1_Channel12, (uint32_t)&aSRC_Buffer, (SRAM2_BASE + (PageIdx * SRAM2_PAGE_SIZE)), (BUFFER_SIZE * 4U)) != HAL_OK)
  {
    Error_Handler();
  }
}

/**
  * @brief  Check SRAM2 pages content
  * @param  None
  * @retval None
  */
static uint32_t Check_SRAM2Page_Content(uint32_t PageIdx, uint32_t WriteProtectionState)
{
  for (uint32_t buffIdx = 0U; buffIdx < 8U; buffIdx++)
  {
    for (uint32_t idx = 0U; idx < BUFFER_SIZE; idx++)
    {
      if (WriteProtectionState == UNPROTECTED)
      {
        if (aSRC_Buffer[idx] != (*(uint32_t *)(SRAM2_BASE + (PageIdx * SRAM2_PAGE_SIZE) + \
          (idx * 4U)  + (buffIdx * BUFFER_SIZE * 4U))))
        {
          return 1U;
        }
      }
      else
      {
        if (0U != (*(uint32_t *)(SRAM2_BASE + (PageIdx * SRAM2_PAGE_SIZE) + \
          (idx * 4U)  + (buffIdx * BUFFER_SIZE * 4U))))
        {
          return 1U;
        }
      }
    }
  }

  return 0U;
}

/**
  * @brief  DMA transfer complete callback
  * @note   This function is executed when the transfer complete interrupt
  *         is generated
  * @retval None
  */
static void TransferComplete(DMA_HandleTypeDef *hdma)
{
  TransferCompleteDetected++;
}

/**
  * @brief  DMA transfer error callback
  * @note   This function is executed when the transfer error interrupt
  *         is generated during DMA transfer
  * @retval None
  */
static void TransferError(DMA_HandleTypeDef *hdma)
{
  TransferErrorDetected++;
}
/* USER CODE END 4 */

void Error_Handler(void)
{
  /* USER CODE BEGIN Error_Handler_Debug */
  /* User can add his own implementation to report the HAL error return state */
  /* Turn LED6 on */
  BSP_LED_On(LED6);
  __disable_irq();
  while (1)
  {
  }
  /* USER CODE END Error_Handler_Debug */
}
